## app/boards/arm/o-invader/Kconfig
```kconfig
# SPDX-License-Identifier: Apache-2.0

config BOARD_ENABLE_DCDC
	bool "DCDC mode"
	select SOC_DCDC_NRF52X
	default n
	depends on BOARD_O_INVADER
```

## app/boards/arm/o-invader/Kconfig.board
```kconfig
# SPDX-License-Identifier: Apache-2.0

config BOARD_O_INVADER
	bool "o-invader"
	depends on SOC_NRF52833_QDAA
```

## app/boards/arm/o-invader/Kconfig.defconfig
```kconfig
# SPDX-License-Identifier: Apache-2.0

if BOARD_O_INVADER

config BOARD
	default "o_invader"

config BT_CTLR
   default BT

endif
```
